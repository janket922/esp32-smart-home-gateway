## sdkconfig.defaults
```kconfig
# ESP32-S3, 16 MiB flash, octal PSRAM, OV2640 DVP
CONFIG_IDF_TARGET="esp32s3"
CONFIG_MBEDTLS_CERTIFICATE_BUNDLE=y
CONFIG_MBEDTLS_CERTIFICATE_BUNDLE_DEFAULT_FULL=y
CONFIG_ESPTOOLPY_FLASHSIZE_16MB=y
CONFIG_ESPTOOLPY_FLASHSIZE="16MB"
CONFIG_PARTITION_TABLE_CUSTOM=y
CONFIG_PARTITION_TABLE_CUSTOM_FILENAME="Partition-16MiB.csv"
CONFIG_EXAMPLE_SELECT_CUSTOMIZED_DEV_BOARD=y
CONFIG_EXAMPLE_ENABLE_DVP_CAM_SENSOR=y
CONFIG_EXAMPLE_DVP_SCCB_I2C_PORT=0
CONFIG_EXAMPLE_DVP_SCCB_I2C_FREQ=100000
CONFIG_EXAMPLE_DVP_XCLK_FREQ=10000000
CONFIG_EXAMPLE_DVP_SCCB_I2C_SCL_PIN=38
CONFIG_EXAMPLE_DVP_SCCB_I2C_SDA_PIN=39
CONFIG_EXAMPLE_DVP_CAM_SENSOR_RESET_PIN=-1
CONFIG_EXAMPLE_DVP_CAM_SENSOR_PWDN_PIN=-1
CONFIG_EXAMPLE_DVP_XCLK_PIN=-1
CONFIG_EXAMPLE_DVP_PCLK_PIN=45
CONFIG_EXAMPLE_DVP_VSYNC_PIN=47
CONFIG_EXAMPLE_DVP_DE_PIN=48
CONFIG_EXAMPLE_DVP_D0_PIN=4
CONFIG_EXAMPLE_DVP_D1_PIN=5
CONFIG_EXAMPLE_DVP_D2_PIN=6
CONFIG_EXAMPLE_DVP_D3_PIN=7
CONFIG_EXAMPLE_DVP_D4_PIN=15
CONFIG_EXAMPLE_DVP_D5_PIN=16
CONFIG_EXAMPLE_DVP_D6_PIN=17
CONFIG_EXAMPLE_DVP_D7_PIN=18
CONFIG_SPIRAM=y
CONFIG_SPIRAM_MODE_OCT=y
CONFIG_SPIRAM_TYPE_AUTO=y
CONFIG_SPIRAM_CLK_IO=30
CONFIG_SPIRAM_CS_IO=26
CONFIG_SPIRAM_SPEED_80M=y
CONFIG_SPIRAM_SPEED=80
CONFIG_SPIRAM_BOOT_HW_INIT=y
CONFIG_SPIRAM_BOOT_INIT=y
CONFIG_SPIRAM_PRE_CONFIGURE_MEMORY_PROTECTION=y
CONFIG_SPIRAM_USE_CAPS_ALLOC=y
CONFIG_SPIRAM_MEMTEST=y
CONFIG_FREERTOS_HZ=1000
CONFIG_ESP_VIDEO_ENABLE_DVP_VIDEO_DEVICE=y
CONFIG_CAMERA_OV2640=y
CONFIG_CAMERA_OV2640_AUTO_DETECT_DVP_INTERFACE_SENSOR=y
CONFIG_CAMERA_OV2640_DVP_JPEG_640X480_25FPS=y
CONFIG_CAMERA_OV2640_DVP_DEFAULT_FMT_JPEG_640X480_25FPS=y
CONFIG_CAMERA_OV2640_DVP_IF_FORMAT_INDEX_DEFAULT=2
CONFIG_SPIRAM_ALLOW_STACK_EXTERNAL_MEMORY=y
CONFIG_CAMERA_OV2640_DVP_JPEG_640x480_25FPS=y
```
